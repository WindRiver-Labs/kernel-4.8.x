## arch/arm/mach-keystone/Kconfig
```kconfig
config ARCH_KEYSTONE
	bool "Texas Instruments Keystone Devices"
	depends on ARCH_MULTI_V7
	select ARCH_SUPPORTS_BIG_ENDIAN
	select ARM_ERRATA_798181 if SMP
	select ARM_GIC
	select COMMON_CLK_KEYSTONE
	select HAVE_ARM_ARCH_TIMER
	select KEYSTONE_TIMER
	select KEYSTONE2_DMA_COHERENT
	select MIGHT_HAVE_PCI
	select PCI_DOMAINS if PCI
	select PM_GENERIC_DOMAINS if PM
	select PINCTRL
	select ZONE_DMA if ARM_LPAE
	help
	  Support for boards based on the Texas Instruments Keystone family of
	  SoCs.

config KEYSTONE2_DMA_COHERENT
	bool
```

## drivers/soc/Kconfig
```kconfig
menu "SOC (System On Chip) specific Drivers"

source "drivers/soc/bcm/Kconfig"
source "drivers/soc/fsl/qe/Kconfig"
source "drivers/soc/mediatek/Kconfig"
source "drivers/soc/qcom/Kconfig"
source "drivers/soc/rockchip/Kconfig"
source "drivers/soc/samsung/Kconfig"
source "drivers/soc/sunxi/Kconfig"
source "drivers/soc/tegra/Kconfig"
source "drivers/soc/ti/Kconfig"
source "drivers/soc/ux500/Kconfig"
source "drivers/soc/versatile/Kconfig"

config	FSL_SOC_DRIVERS
	bool "Freescale Soc Drivers"
	depends on FSL_SOC || ARCH_MXC
	default n
	help
	Say y here to enable Freescale Soc Device Drivers support.
	The Soc Drivers provides the device driver that is a specific block
	or feature on Freescale platform.

if FSL_SOC_DRIVERS
	source "drivers/soc/fsl/Kconfig"
endif

endmenu
```

## drivers/staging/lttng/Kconfig
```kconfig
config LTTNG
	tristate "LTTng support"
	depends on TRACEPOINTS
	select VIRTUALIZATION if X86
	select KVM if X86
	select KVM_INTEL if X86
	select KVM_AMD if X86
	help
	  LTTng is an open source tracing framework for Linux.

	  See https://lttng.org/

	  To compile as a set of modules, choose M here. To compile into
	  the Linux kernel image, choose Y.

	  If unsure, say N.

source "drivers/staging/lttng/tests/Kconfig"
```

## drivers/staging/netatop/Kconfig
```kconfig
config NETATOP
	tristate "Net statistics collector for atop"
	default n
	---help---
	  netatop is used to gather statistics about the TCP and UDP packets
	  that have been transmitted/received per process and per thread. As
	  soon as atop discovers that this module is active, it shows the
	  columns SNET and RNET in the generic screen for the number of
	  transmitted and received packets per process. When the 'n' key is
	  pressed, it shows detailed counters about the number packets
	  transmitted/received via TCP and UDP, the average sizes of these
	  packets, and the total bandwidth consumed for input and output per
	  process/thread.
```

## fs/vmfs/Kconfig
```kconfig
config VMFS_FS
	tristate "VMFS file system support (to mount host directories etc.)"
	select NLS
	default y if ARCH_AXXIA
	help
	  Say Y here to enable support for accessing the host filesystem
	  when running the kernel in a virtual platform built with the Fast
	  Models product from ARM.

config VMFS_DEV_BASE
	hex "VMFS base address"
	depends on VMFS_FS
	default 0x8021010000
```

## sound/soc/generic/Kconfig
```kconfig
config SND_SIMPLE_CARD_UTILS
       tristate

config SND_SIMPLE_CARD
	tristate "ASoC Simple sound card support"
	select SND_SIMPLE_CARD_UTILS
	select SND_SOC_ADAU1761_I2C
	help
	  This option enables generic simple sound card support
```
